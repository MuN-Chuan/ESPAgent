## firmware/esp32_display/main/Kconfig.projbuild
```kconfig
menu "ESPAgent Demo Configuration"

config ESPAGENT_WIFI_SSID
    string "WiFi SSID"
    default ""

config ESPAGENT_WIFI_PASSWORD
    string "WiFi Password"
    default ""

config ESPAGENT_UDP_PORT
    int "Display UDP port"
    default 39000

config ESPAGENT_STATUS_PORT
    int "Display status UDP port"
    default 39001

endmenu
```

## firmware/esp32_display/sdkconfig.defaults
```kconfig
CONFIG_PARTITION_TABLE_CUSTOM=y
CONFIG_PARTITION_TABLE_CUSTOM_FILENAME="partitions.csv"
CONFIG_PARTITION_TABLE_FILENAME="partitions.csv"

CONFIG_SPIRAM=y
CONFIG_SPIRAM_MODE_OCT=y
CONFIG_SPIRAM_TYPE_AUTO=y
CONFIG_SPIRAM_SPEED_80M=y
CONFIG_SPIRAM_USE_MALLOC=y
CONFIG_SPIRAM_MALLOC_ALWAYSINTERNAL=16384
CONFIG_SPIRAM_TRY_ALLOCATE_WIFI_LWIP=y
CONFIG_SPIRAM_MALLOC_RESERVE_INTERNAL=65536

CONFIG_ESP_CONSOLE_UART_DEFAULT=y
CONFIG_ESP_CONSOLE_UART_NUM=0
CONFIG_ESP_CONSOLE_ROM_SERIAL_PORT_NUM=0
CONFIG_ESP_CONSOLE_SECONDARY_USB_SERIAL_JTAG=y

CONFIG_MBEDTLS_SSL_PROTO_DTLS=y

CONFIG_LWIP_SO_RCVBUF=y
CONFIG_LWIP_UDP_RECVMBOX_SIZE=64
```
